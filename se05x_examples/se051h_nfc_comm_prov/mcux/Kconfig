## se05x_examples/se051h_nfc_comm_prov/mcux/Kconfig
```kconfig
#
# Copyright 2025-2026 NXP
# SPDX-License-Identifier: BSD-3-Clause

mainmenu "SE05X nfc commissioning example"

rsource "$(CHIP_ROOT)/third_party/simw-top-mini/repo/matter/se05x_demos_common/Kconfig.se05x.common"
```
